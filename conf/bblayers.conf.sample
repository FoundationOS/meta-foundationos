## conf/bblayers.conf.sample
```bitbake
# POKY_BBLAYERS_CONF_VERSION is increased each time build/conf/bblayers.conf
# changes incompatibly
POKY_BBLAYERS_CONF_VERSION = "2"

BBPATH = "${TOPDIR}"
BBFILES ?= ""

TOP = "${TOPDIR}/../.."
YOCTO_ROOT= "${TOP}/platform/yocto"

BBLAYERS ?= " \
    ${YOCTO_ROOT}/poky/meta \
    ${YOCTO_ROOT}/poky/meta-poky \
    ${YOCTO_ROOT}/meta-openembedded/meta-oe \
    ${YOCTO_ROOT}/meta-openembedded/meta-multimedia \
    ${YOCTO_ROOT}/meta-openembedded/meta-networking \
    ${YOCTO_ROOT}/meta-openembedded/meta-python \
    ${YOCTO_ROOT}/meta-foundationos \
    ${YOCTO_ROOT}/meta-foundationos-qemu/meta-foundationos-qemux86-64 \
"
```

## conf/layer.conf
```bitbake
BBPATH .= ":${LAYERDIR}"

# We have a recipes directory, add to BBFILES
BBFILES += "${LAYERDIR}/recipes*/*/*.bb ${LAYERDIR}/recipes*/*/*.bbappend ${LAYERDIR}/images/*.bb"

BBFILE_COLLECTIONS += "meta-foundationos"
BBFILE_PATTERN_meta-foundationos= "^${LAYERDIR}/"
BBFILE_PRIORITY_meta-foundationos= "10"

INHERIT += "foundationos-setup"
```
